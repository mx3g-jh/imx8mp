## sources/uboot-imx/board/freescale/imx93_frdm/Kconfig
```kconfig
if TARGET_IMX93_11X11_FRDM

config SYS_BOARD
	default "imx93_frdm"

config SYS_VENDOR
	default "freescale"

config SYS_CONFIG_NAME
	default "imx93_frdm"

config IMX93_FRDM_LPDDR4X
	bool "Using LPDDR4X Timing and PMIC voltage"
	default y
	select IMX9_LPDDR4X
	help
	  Select the LPDDR4X timing and 0.6V VDDQ

endif
```
