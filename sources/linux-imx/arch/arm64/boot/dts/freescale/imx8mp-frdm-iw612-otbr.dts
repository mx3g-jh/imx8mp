// SPDX-License-Identifier: (GPL-2.0+ OR MIT)
/*
 * Copyright 2025 NXP
 */

#include "imx8mp-frdm.dts"

&i2c2 {
	pcal6408: gpio@20 {
		compatible = "nxp,pcal9554b";
		reg = <0x20>;
		gpio-controller;
		#gpio-cells = <2>;
		vcc-supply = <&reg_usdhc1_vmmc>;
		status = "okay";
	};
};

&ecspi2 {
	pinctrl-assert-gpios = <&pcal6408 0 GPIO_ACTIVE_HIGH>;
};
